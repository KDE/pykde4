## docs/html/kdecore/KConfig.html
```kconfig
<?xml version="1.0" encoding="UTF-8"?>
<!DOCTYPE html PUBLIC "-//W3C//DTD XHTML 1.0 Transitional//EN" "http://www.w3.org/TR/xhtml1/DTD/xhtml1-transitional.dtd">
<html xmlns="http://www.w3.org/1999/xhtml" lang="en" xml:lang="en">

<head>
  <title>KConfig</title>
  <meta http-equiv="Content-Type" content="text/html; charset=utf-8" />
  <meta http-equiv="Content-Style-Type" content="text/css" />
  <link rel="stylesheet" type="text/css" href="../common/doxygen.css" />
  <link rel="stylesheet" media="screen" type="text/css" title="KDE Colors" href="../common/kde.css" />
</head>
<body>
<div id="container">
<div id="header">
  <div id="header_top">
    <div>
      <div>
        <img alt ="" src="../common/top-kde.jpg"/>
        KDE 4.9 PyKDE API Reference
      </div>
    </div>
  </div>
  <div id="header_bottom">
    <div id="location">
      <ul>
        <li>KDE's Python API</li>
      </ul>
    </div>

    <div id="menu">
      <ul>
        <li><a href="../modules.html">Overview</a></li>
<li><a href="http://techbase.kde.org/Development/Languages/Python">PyKDE Home</a></li>
<li><a href="http://kde.org/family/">Sitemap</a></li>
<li><a href="http://kde.org/contact/">Contact Us</a></li>
</ul>
    </div>
  </div>
</div>

<div id="body_wrapper">
<div id="body">
<div id="right">
<div class="content">
<div id="main">
<div class="clearer">&nbsp;</div>

<h1>KConfig Class Reference</h1>
<code>from PyKDE4.kdecore import *</code>
<p>
Inherits: <a href="../kdecore/KConfigBase.html">KConfigBase</a><br />
Subclasses: <a href="../kdecore/KDesktopFile.html">KDesktopFile</a>, <a href="../kdecore/KSharedConfig.html">KSharedConfig</a><br />

<h2>Detailed Description</h2>

<p>\class KConfig kconfig.h &lt;KConfig&gt;
</p>
<p>
The central class of the KDE configuration data system.
</p>
<p>
Quickstart:
</p>
<p>
Get the default application config object via KGlobal.config().
</p>
<p>
Load a specific configuration file:
<pre class="fragment">
 KConfig config( "/etc/kderc", KConfig.SimpleConfig );
</pre>
</p>
<p>
Load the configuration of a specific component (taking into account
possible custom directories in KStandardDirs):
<pre class="fragment">
 KConfig config( componentData(), "pluginrc" );
</pre>
</p>
<p>
In general it is recommended to use KSharedConfig instead of
creating multiple instances of KConfig to avoid the overhead of
separate objects or concerns about synchronizing writes to disk
even if the configuration object is updated from multiple code paths.
KSharedConfig provides a set of open methods as counterparts for the
KConfig constructors.
</p>
<p>
\sa KSharedConfig, KConfigGroup, <a href="http://techbase.kde.org/index.php?title=Development/Tutorials/KConfig">the techbase HOWTO on KConfig</a>.
</p>
<table border="0" cellpadding="0" cellspacing="0"><tr><td colspan="2"><br><h2>Enumerations</h2></td></tr>
<tr><td class="memItemLeft" nowrap align="right" valign="top"><a class="el" href="#OpenFlag">OpenFlag</a>&nbsp;</td><td class="memItemRight" valign="bottom">{&nbsp;IncludeGlobals, CascadeConfig, SimpleConfig, NoCascade, NoGlobals, FullConfig&nbsp;}</td></tr>
<tr><td colspan="2"><br><h2>Methods</h2></td></tr>
<tr><td class="memItemLeft" nowrap align="right" valign="top">&nbsp;</td><td class="memItemRight" valign="bottom"><a class="el" href="#KConfig">__init__</a> (self, QString file=QString(), <a href="../kdecore/KConfig.html">KConfig.OpenFlags</a> mode=KConfig.FullConfig, QString resourceType="config")</td></tr>
<tr><td class="memItemLeft" nowrap align="right" valign="top">&nbsp;</td><td class="memItemRight" valign="bottom"><a class="el" href="#KConfig">__init__</a> (self, <a href="../kdecore/KComponentData.html">KComponentData</a> componentData, QString file=QString(), <a href="../kdecore/KConfig.html">KConfig.OpenFlags</a> mode=KConfig.FullConfig, QString resourceType="config")</td></tr>
<tr><td class="memItemLeft" nowrap align="right" valign="top">&nbsp;</td><td class="memItemRight" valign="bottom"><a class="el" href="#KConfig">__init__</a> (self, QString file, QString backend, QString resourceType="config")</td></tr>
<tr><td class="memItemLeft" nowrap align="right" valign="top">&nbsp;</td><td class="memItemRight" valign="bottom"><a class="el" href="#KConfig">__init__</a> (self, <a href="../kdecore/KConfig.html">KConfig</a> a0)</td></tr>
<tr><td class="memItemLeft" nowrap align="right" valign="top"><a href="../kdecore/KConfigBase.html#AccessMode">KConfigBase.AccessMode</a>&nbsp;</td><td class="memItemRight" valign="bottom"><a class="el" href="#accessMode">accessMode</a> (self)</td></tr>
<tr><td class="memItemLeft" nowrap align="right" valign="top">&nbsp;</td><td class="memItemRight" valign="bottom"><a class="el" href="#addConfigSources">addConfigSources</a> (self, QStringList sources)</td></tr>
<tr><td class="memItemLeft" nowrap align="right" valign="top">&nbsp;</td><td class="memItemRight" valign="bottom"><a class="el" href="#checkUpdate">checkUpdate</a> (self, QString id, QString updateFile)</td></tr>
<tr><td class="memItemLeft" nowrap align="right" valign="top"><a href="../kdecore/KComponentData.html">KComponentData</a>&nbsp;</td><td class="memItemRight" valign="bottom"><a class="el" href="#componentData">componentData</a> (self)</td></tr>
<tr><td class="memItemLeft" nowrap align="right" valign="top"><a href="../kdecore/KConfig.html">KConfig</a>&nbsp;</td><td class="memItemRight" valign="bottom"><a class="el" href="#copyTo">copyTo</a> (self, QString file, <a href="../kdecore/KConfig.html">KConfig</a> config=0)</td></tr>
<tr><td class="memItemLeft" nowrap align="right" valign="top">&nbsp;</td><td class="memItemRight" valign="bottom"><a class="el" href="#deleteGroupImpl">deleteGroupImpl</a> (self, QByteArray group, <a href="../kdecore/KConfigBase.html">KConfigBase.WriteConfigFlags</a> flags=KConfigBase.Normal)</td></tr>
<tr><td class="memItemLeft" nowrap align="right" valign="top">{QString:QString}&nbsp;</td><td class="memItemRight" valign="bottom"><a class="el" href="#entryMap">entryMap</a> (self, QString aGroup=QString())</td></tr>
<tr><td class="memItemLeft" nowrap align="right" valign="top">bool&nbsp;</td><td class="memItemRight" valign="bottom"><a class="el" href="#forceGlobal">forceGlobal</a> (self)</td></tr>
<tr><td class="memItemLeft" nowrap align="right" valign="top"><a href="../kdecore/KConfigGroup.html">KConfigGroup</a>&nbsp;</td><td class="memItemRight" valign="bottom"><a class="el" href="#groupImpl">groupImpl</a> (self, QByteArray b)</td></tr>
<tr><td class="memItemLeft" nowrap align="right" valign="top">QStringList&nbsp;</td><td class="memItemRight" valign="bottom"><a class="el" href="#groupList">groupList</a> (self)</td></tr>
<tr><td class="memItemLeft" nowrap align="right" valign="top">bool&nbsp;</td><td class="memItemRight" valign="bottom"><a class="el" href="#hasGroupImpl">hasGroupImpl</a> (self, QByteArray group)</td></tr>
<tr><td class="memItemLeft" nowrap align="right" valign="top">bool&nbsp;</td><td class="memItemRight" valign="bottom"><a class="el" href="#isConfigWritable">isConfigWritable</a> (self, bool warnUser)</td></tr>
<tr><td class="memItemLeft" nowrap align="right" valign="top">bool&nbsp;</td><td class="memItemRight" valign="bottom"><a class="el" href="#isGroupImmutableImpl">isGroupImmutableImpl</a> (self, QByteArray aGroup)</td></tr>
<tr><td class="memItemLeft" nowrap align="right" valign="top">bool&nbsp;</td><td class="memItemRight" valign="bottom"><a class="el" href="#isImmutable">isImmutable</a> (self)</td></tr>
<tr><td class="memItemLeft" nowrap align="right" valign="top">QString&nbsp;</td><td class="memItemRight" valign="bottom"><a class="el" href="#locale">locale</a> (self)</td></tr>
<tr><td class="memItemLeft" nowrap align="right" valign="top">&nbsp;</td><td class="memItemRight" valign="bottom"><a class="el" href="#markAsClean">markAsClean</a> (self)</td></tr>
<tr><td class="memItemLeft" nowrap align="right" valign="top">QString&nbsp;</td><td class="memItemRight" valign="bottom"><a class="el" href="#name">name</a> (self)</td></tr>
<tr><td class="memItemLeft" nowrap align="right" valign="top">bool&nbsp;</td><td class="memItemRight" valign="bottom"><a class="el" href="#readDefaults">readDefaults</a> (self)</td></tr>
<tr><td class="memItemLeft" nowrap align="right" valign="top">&nbsp;</td><td class="memItemRight" valign="bottom"><a class="el" href="#reparseConfiguration">reparseConfiguration</a> (self)</td></tr>
<tr><td class="memItemLeft" nowrap align="right" valign="top">&nbsp;</td><td class="memItemRight" valign="bottom"><a class="el" href="#setForceGlobal">setForceGlobal</a> (self, bool force)</td></tr>
<tr><td class="memItemLeft" nowrap align="right" valign="top">bool&nbsp;</td><td class="memItemRight" valign="bottom"><a class="el" href="#setLocale">setLocale</a> (self, QString aLocale)</td></tr>
<tr><td class="memItemLeft" nowrap align="right" valign="top">&nbsp;</td><td class="memItemRight" valign="bottom"><a class="el" href="#setReadDefaults">setReadDefaults</a> (self, bool b)</td></tr>
<tr><td class="memItemLeft" nowrap align="right" valign="top">&nbsp;</td><td class="memItemRight" valign="bottom"><a class="el" href="#sync">sync</a> (self)</td></tr>
</table>
<hr><h2>Method Documentation</h2><a class="anchor" name="KConfig"></a>
<div class="memitem">
<div class="memproto">
<table class="memname"><tr>
<td class="memname">__init__</td>
<td>(</td>
<td class="paramtype">&nbsp;<em>self</em>, </td>
<td class="paramname"></td>
</tr><tr>
<td class="memname"></td>
<td></td>
<td class="paramtype">QString&nbsp;</td>
<td class="paramname"><em>file=QString()</em>, </td>
</tr>
<tr>
<td class="memname"></td>
<td></td>
<td class="paramtype"><a href="../kdecore/KConfig.html">KConfig.OpenFlags</a>&nbsp;</td>
<td class="paramname"><em>mode=KConfig.FullConfig</em>, </td>
</tr>
<tr>
<td class="memname"></td>
<td></td>
<td class="paramtype">QString&nbsp;</td>
<td class="paramname"><em>resourceType="config"</em></td>
</tr>
<tr>
<td></td>
<td>)</td>
<td></td>
<td></td>
<td width="100%"> </td>
</tr></table>
</div>
<div class="memdoc"><p>Creates a KConfig object to manipulate a configuration file for the
current application.
</p>
<p>
If an absolute path is specified for <b>file,</b> that file will be used
as the store for the configuration settings. If a non-absolute path
is provided, the file will be looked for in the standard directory
specified by resourceType. If no path is provided, a default
configuration file will be used based on the name of the main
application component.
</p>
<p>
<b>mode</b> determines whether the user or global settings will be allowed
to influence the values returned by this object. See OpenFlags for
more details.
</p>
<p>
<dl class="note" compact><dt><b>Note:</b></dt><dd> You probably want to use KSharedConfig.openConfig instead.
</dd></dl> </p>
<p>
</p><dl compact><dt><b>Parameters:</b></dt><dd>
<table border="0" cellspacing="2" cellpadding="0">
<tr><td></td><td valign="top"><em>file</em>&nbsp;</td><td> the name of the file. If an empty string is passed in
and SimpleConfig is passed in for the OpenFlags, then an in-memory
KConfig object is created which will not write out to file nor which
requires any file in the filesystem at all.

<tr><td></td><td valign="top"><em>mode</em>&nbsp;</td><td> how global settings should affect the configuration
options exposed by this KConfig object

<tr><td></td><td valign="top"><em>resourceType</em>&nbsp;</td><td> The standard directory to look for the configuration
file in (see KStandardDirs)
</td></tr>
</table></dl>
<p> @sa KSharedConfig.openConfig(const QString&amp;, OpenFlags, const char*)
</p></div></div><a class="anchor" name="KConfig"></a>
<div class="memitem">
<div class="memproto">
<table class="memname"><tr>
<td class="memname">__init__</td>
<td>(</td>
<td class="paramtype">&nbsp;<em>self</em>, </td>
<td class="paramname"></td>
</tr><tr>
<td class="memname"></td>
<td></td>
<td class="paramtype"><a href="../kdecore/KComponentData.html">KComponentData</a>&nbsp;</td>
<td class="paramname"><em>componentData</em>, </td>
</tr>
<tr>
<td class="memname"></td>
<td></td>
<td class="paramtype">QString&nbsp;</td>
<td class="paramname"><em>file=QString()</em>, </td>
</tr>
<tr>
<td class="memname"></td>
<td></td>
<td class="paramtype"><a href="../kdecore/KConfig.html">KConfig.OpenFlags</a>&nbsp;</td>
<td class="paramname"><em>mode=KConfig.FullConfig</em>, </td>
</tr>
<tr>
<td class="memname"></td>
<td></td>
<td class="paramtype">QString&nbsp;</td>
<td class="paramname"><em>resourceType="config"</em></td>
</tr>
<tr>
<td></td>
<td>)</td>
<td></td>
<td></td>
<td width="100%"> </td>
</tr></table>
</div>
<div class="memdoc"><p>Creates a KConfig object to manipulate the configuration for a specific
component.
</p>
<p>
If an absolute path is specified for <b>file,</b> that file will be used
as the store for the configuration settings. If a non-absolute path
is provided, the file will be looked for in the standard directory
specified by resourceType. If no path is provided, a default
configuration file will be used based on the component's name.
</p>
<p>
<b>mode</b> determines whether the user or global settings will be allowed
to influence the values returned by this object. See KConfig.OpenFlags for
more details.
</p>
<p>
<dl class="note" compact><dt><b>Note:</b></dt><dd> You probably want to use KSharedConfig.openConfig instead.
</dd></dl> </p>
<p>
</p><dl compact><dt><b>Parameters:</b></dt><dd>
<table border="0" cellspacing="2" cellpadding="0">
<tr><td></td><td valign="top"><em>componentData</em>&nbsp;</td><td> the component that you wish to load a configuration
file for

<tr><td></td><td valign="top"><em>file</em>&nbsp;</td><td> overrides the configuration file name if not empty; if it is empty
and SimpleConfig is passed in for the OpenFlags, then an in-memory
KConfig object is created which will not write out to file nor which
requires any file in the filesystem at all.

<tr><td></td><td valign="top"><em>mode</em>&nbsp;</td><td> how global settings should affect the configuration
options exposed by this KConfig object.
See OpenFlags

<tr><td></td><td valign="top"><em>resourceType</em>&nbsp;</td><td> The standard directory to look for the configuration
file in
</td></tr>
</table></dl>
<p> @sa KSharedConfig.openConfig(const KComponentData&amp;, const QString&amp;, OpenFlags, const char*)
</p></div></div><a class="anchor" name="KConfig"></a>
<div class="memitem">
<div class="memproto">
<table class="memname"><tr>
<td class="memname">__init__</td>
<td>(</td>
<td class="paramtype">&nbsp;<em>self</em>, </td>
<td class="paramname"></td>
</tr><tr>
<td class="memname"></td>
<td></td>
<td class="paramtype">QString&nbsp;</td>
<td class="paramname"><em>file</em>, </td>
</tr>
<tr>
<td class="memname"></td>
<td></td>
<td class="paramtype">QString&nbsp;</td>
<td class="paramname"><em>backend</em>, </td>
</tr>
<tr>
<td class="memname"></td>
<td></td>
<td class="paramtype">QString&nbsp;</td>
<td class="paramname"><em>resourceType="config"</em></td>
</tr>
<tr>
<td></td>
<td>)</td>
<td></td>
<td></td>
<td width="100%"> </td>
</tr></table>
</div>
<div class="memdoc"><p><dl class="internal" compact><dt><b>Internal:</b></dt><dd>
</dd></dl> </p>
<p>
Creates a KConfig object using the specified backend. If the backend can not
be found or loaded, then the standard configuration parser is used as a fallback.
</p>
<p>
</p><dl compact><dt><b>Parameters:</b></dt><dd>
<table border="0" cellspacing="2" cellpadding="0">
<tr><td></td><td valign="top"><em>file</em>&nbsp;</td><td> the file to be parsed

<tr><td></td><td valign="top"><em>backend</em>&nbsp;</td><td> the backend to load

<tr><td></td><td valign="top"><em>resourceType</em>&nbsp;</td><td> where to look for the file if an absolute path is not provided
</td></tr>
</table></dl>
<p> <dl class="since" compact><dt><b>Since:</b></dt><dd> 4.1
</dd></dl>
</p></div></div><a class="anchor" name="KConfig"></a>
<div class="memitem">
<div class="memproto">
<table class="memname"><tr>
<td class="memname">__init__</td>
<td>(</td>
<td class="paramtype">&nbsp;<em>self</em>, </td>
<td class="paramname"></td>
</tr><tr>
<td class="memname"></td>
<td></td>
<td class="paramtype"><a href="../kdecore/KConfig.html">KConfig</a>&nbsp;</td>
<td class="paramname"><em>a0</em></td>
</tr>
<tr>
<td></td>
<td>)</td>
<td></td>
<td></td>
<td width="100%"> </td>
</tr></table>
</div>
<div class="memdoc"></div></div><a class="anchor" name="accessMode"></a>
<div class="memitem">
<div class="memproto">
<table class="memname"><tr>
<td class="memname"><a href="../kdecore/KConfigBase.html#AccessMode">KConfigBase.AccessMode</a> accessMode</td>
<td>(</td>
<td class="paramtype">&nbsp;</td>
<td class="paramname"><em>self</em>&nbsp;)</td>
<td width="100%"> </td>
</tr>
</table>
</div>
<div class="memdoc"></div></div><a class="anchor" name="addConfigSources"></a>
<div class="memitem">
<div class="memproto">
<table class="memname"><tr>
<td class="memname"> addConfigSources</td>
<td>(</td>
<td class="paramtype">&nbsp;<em>self</em>, </td>
<td class="paramname"></td>
</tr><tr>
<td class="memname"></td>
<td></td>
<td class="paramtype">QStringList&nbsp;</td>
<td class="paramname"><em>sources</em></td>
</tr>
<tr>
<td></td>
<td>)</td>
<td></td>
<td></td>
<td width="100%"> </td>
</tr></table>
</div>
<div class="memdoc"><p>Adds the list of configuration sources to the merge stack.
</p>
<p>
Currently only files are accepted as configuration sources.
</p>
<p>
The first entry in <b>sources</b> is treated as the most general and will
be overridden by the second entry. The settings in the final entry
in <b>sources</b> will override all the other sources provided in the list.
</p>
<p>
The settings in <b>sources</b> will also be overridden by the sources
provided by any previous calls to addConfigSources().
</p>
<p>
The settings in the global configuration sources will be overridden by
the sources provided to this method (@see IncludeGlobals).
All the sources provided to any call to this method will be overridden
by any files that cascade from the source provided to the constructor
(@see CascadeConfig), which will in turn be
overridden by the source provided to the constructor (either explicitly
or implicity via a KComponentData).
</p>
<p>
Note that only the most specific file, ie: the file provided to the
constructor, will be written to by this object.
</p>
<p>
The state is automatically updated by this method, so there is no need to call
reparseConfiguration().
</p>
<p>
</p><dl compact><dt><b>Parameters:</b></dt><dd>
<table border="0" cellspacing="2" cellpadding="0">
<tr><td></td><td valign="top"><em>sources</em>&nbsp;</td><td> A list of extra config sources.
</td></tr>
</table></dl>
<p>
</p></div></div><a class="anchor" name="checkUpdate"></a>
<div class="memitem">
<div class="memproto">
<table class="memname"><tr>
<td class="memname"> checkUpdate</td>
<td>(</td>
<td class="paramtype">&nbsp;<em>self</em>, </td>
<td class="paramname"></td>
</tr><tr>
<td class="memname"></td>
<td></td>
<td class="paramtype">QString&nbsp;</td>
<td class="paramname"><em>id</em>, </td>
</tr>
<tr>
<td class="memname"></td>
<td></td>
<td class="paramtype">QString&nbsp;</td>
<td class="paramname"><em>updateFile</em></td>
</tr>
<tr>
<td></td>
<td>)</td>
<td></td>
<td></td>
<td width="100%"> </td>
</tr></table>
</div>
<div class="memdoc"><p>Ensures that the configuration file contains a certain update.
</p>
<p>
If the configuration file does not contain the update <b>id</b>
as contained in <b>updateFile,</b> kconf_update is run to update
the configuration file.
</p>
<p>
If you install config update files with critical fixes
you may wish to use this method to verify that a critical
update has indeed been performed to catch the case where
a user restores an old config file from backup that has
not been updated yet.
</p>
<p>
</p><dl compact><dt><b>Parameters:</b></dt><dd>
<table border="0" cellspacing="2" cellpadding="0">
<tr><td></td><td valign="top"><em>id</em>&nbsp;</td><td> the update to check

<tr><td></td><td valign="top"><em>updateFile</em>&nbsp;</td><td> the file containing the update
</td></tr>
</table></dl>
<p>
</p></div></div><a class="anchor" name="componentData"></a>
<div class="memitem">
<div class="memproto">
<table class="memname"><tr>
<td class="memname"><a href="../kdecore/KComponentData.html">KComponentData</a> componentData</td>
<td>(</td>
<td class="paramtype">&nbsp;</td>
<td class="paramname"><em>self</em>&nbsp;)</td>
<td width="100%"> </td>
</tr>
</table>
</div>
<div class="memdoc"><p>Returns the component data this configuration is for.
</p></div></div><a class="anchor" name="copyTo"></a>
<div class="memitem">
<div class="memproto">
<table class="memname"><tr>
<td class="memname"><a href="../kdecore/KConfig.html">KConfig</a> copyTo</td>
<td>(</td>
<td class="paramtype">&nbsp;<em>self</em>, </td>
<td class="paramname"></td>
</tr><tr>
<td class="memname"></td>
<td></td>
<td class="paramtype">QString&nbsp;</td>
<td class="paramname"><em>file</em>, </td>
</tr>
<tr>
<td class="memname"></td>
<td></td>
<td class="paramtype"><a href="../kdecore/KConfig.html">KConfig</a>&nbsp;</td>
<td class="paramname"><em>config=0</em></td>
</tr>
<tr>
<td></td>
<td>)</td>
<td></td>
<td></td>
<td width="100%"> </td>
</tr></table>
</div>
<div class="memdoc"><p>Copies all entries from this config object to a new config
object that will save itself to <b>file.</b>
</p>
<p>
The configuration will not actually be saved to <b>file</b>
until the returned object is destroyed, or sync() is called
on it.
</p>
<p>
Do not forget to delete the returned KConfig object if
<b>config</b> was 0.
</p>
<p>
</p><dl compact><dt><b>Parameters:</b></dt><dd>
<table border="0" cellspacing="2" cellpadding="0">
<tr><td></td><td valign="top"><em>file</em>&nbsp;</td><td> the new config object will save itself to

<tr><td></td><td valign="top"><em>config</em>&nbsp;</td><td> if not 0, copy to the given KConfig object rather
than creating a new one
</td></tr>
</table></dl>
<p> <dl class="return" compact><dt><b>Returns:</b></dt><dd> <b>config</b> if it was set, otherwise a new KConfig object
</dd></dl>
</p></div></div><a class="anchor" name="deleteGroupImpl"></a>
<div class="memitem">
<div class="memproto">
<table class="memname"><tr>
<td class="memname"> deleteGroupImpl</td>
<td>(</td>
<td class="paramtype">&nbsp;<em>self</em>, </td>
<td class="paramname"></td>
</tr><tr>
<td class="memname"></td>
<td></td>
<td class="paramtype">QByteArray&nbsp;</td>
<td class="paramname"><em>group</em>, </td>
</tr>
<tr>
<td class="memname"></td>
<td></td>
<td class="paramtype"><a href="../kdecore/KConfigBase.html">KConfigBase.WriteConfigFlags</a>&nbsp;</td>
<td class="paramname"><em>flags=KConfigBase.Normal</em></td>
</tr>
<tr>
<td></td>
<td>)</td>
<td></td>
<td></td>
<td width="100%"> </td>
</tr></table>
</div>
<div class="memdoc"></div></div><a class="anchor" name="entryMap"></a>
<div class="memitem">
<div class="memproto">
<table class="memname"><tr>
<td class="memname">{QString:QString} entryMap</td>
<td>(</td>
<td class="paramtype">&nbsp;<em>self</em>, </td>
<td class="paramname"></td>
</tr><tr>
<td class="memname"></td>
<td></td>
<td class="paramtype">QString&nbsp;</td>
<td class="paramname"><em>aGroup=QString()</em></td>
</tr>
<tr>
<td></td>
<td>)</td>
<td></td>
<td></td>
<td width="100%"> </td>
</tr></table>
</div>
<div class="memdoc"><p>Returns a map (tree) of entries in a particular group.
</p>
<p>
The entries are all returned as strings.
</p>
<p>
</p><dl compact><dt><b>Parameters:</b></dt><dd>
<table border="0" cellspacing="2" cellpadding="0">
<tr><td></td><td valign="top"><em>aGroup</em>&nbsp;</td><td> The group to get entries from.
</td></tr>
</table></dl>
<p> <dl class="return" compact><dt><b>Returns:</b></dt><dd> A map of entries in the group specified, indexed by key.
The returned map may be empty if the group is empty, or not found.
</dd></dl> <dl class="see" compact><dt><b>See also:</b></dt><dd> QMap
</dd></dl>
</p></div></div><a class="anchor" name="forceGlobal"></a>
<div class="memitem">
<div class="memproto">
<table class="memname"><tr>
<td class="memname">bool forceGlobal</td>
<td>(</td>
<td class="paramtype">&nbsp;</td>
<td class="paramname"><em>self</em>&nbsp;)</td>
<td width="100%"> </td>
</tr>
</table>
</div>
<div class="memdoc"><p><dl class="deprecated" compact><dt><b>Deprecated:</b></dt><dd>
</dd></dl> </p>
<p>
Returns whether all entries are being written to kdeglobals.
</p>
<p>
<dl class="return" compact><dt><b>Returns:</b></dt><dd> true if all entries are being written to kdeglobals
</dd></dl> <dl class="see" compact><dt><b>See also:</b></dt><dd> setForceGlobal
</dd></dl> <dl class="deprecated" compact><dt><b>Deprecated:</b></dt><dd>
</dd></dl>
</p></div></div><a class="anchor" name="groupImpl"></a>
<div class="memitem">
<div class="memproto">
<table class="memname"><tr>
<td class="memname"><a href="../kdecore/KConfigGroup.html">KConfigGroup</a> groupImpl</td>
<td>(</td>
<td class="paramtype">&nbsp;<em>self</em>, </td>
<td class="paramname"></td>
</tr><tr>
<td class="memname"></td>
<td></td>
<td class="paramtype">QByteArray&nbsp;</td>
<td class="paramname"><em>b</em></td>
</tr>
<tr>
<td></td>
<td>)</td>
<td></td>
<td></td>
<td width="100%"> </td>
</tr></table>
</div>
<div class="memdoc"></div></div><a class="anchor" name="groupList"></a>
<div class="memitem">
<div class="memproto">
<table class="memname"><tr>
<td class="memname">QStringList groupList</td>
<td>(</td>
<td class="paramtype">&nbsp;</td>
<td class="paramname"><em>self</em>&nbsp;)</td>
<td width="100%"> </td>
</tr>
</table>
</div>
<div class="memdoc"></div></div><a class="anchor" name="hasGroupImpl"></a>
<div class="memitem">
<div class="memproto">
<table class="memname"><tr>
<td class="memname">bool hasGroupImpl</td>
<td>(</td>
<td class="paramtype">&nbsp;<em>self</em>, </td>
<td class="paramname"></td>
</tr><tr>
<td class="memname"></td>
<td></td>
<td class="paramtype">QByteArray&nbsp;</td>
<td class="paramname"><em>group</em></td>
</tr>
<tr>
<td></td>
<td>)</td>
<td></td>
<td></td>
<td width="100%"> </td>
</tr></table>
</div>
<div class="memdoc"></div></div><a class="anchor" name="isConfigWritable"></a>
<div class="memitem">
<div class="memproto">
<table class="memname"><tr>
<td class="memname">bool isConfigWritable</td>
<td>(</td>
<td class="paramtype">&nbsp;<em>self</em>, </td>
<td class="paramname"></td>
</tr><tr>
<td class="memname"></td>
<td></td>
<td class="paramtype">bool&nbsp;</td>
<td class="paramname"><em>warnUser</em></td>
</tr>
<tr>
<td></td>
<td>)</td>
<td></td>
<td></td>
<td width="100%"> </td>
</tr></table>
</div>
<div class="memdoc"><p>Whether the configuration can be written to.
</p>
<p>
If <b>warnUser</b> is true and the configuration cannot be
written to (ie: this method returns false), a warning
message box will be shown to the user telling them to
contact their system administrator to get the problem fixed.
</p>
<p>
The most likely cause for this method returning false
is that the user does not have write permission for the
configuration file.
</p>
<p>
</p><dl compact><dt><b>Parameters:</b></dt><dd>
<table border="0" cellspacing="2" cellpadding="0">
<tr><td></td><td valign="top"><em>warnUser</em>&nbsp;</td><td> whether to show a warning message to the user
if the configuration cannot be written to
</td></tr>
</table></dl>
<p> <dl class="return" compact><dt><b>Returns:</b></dt><dd> true if the configuration can be written to, false
if the configuration cannot be written to
</dd></dl>
</p></div></div><a class="anchor" name="isGroupImmutableImpl"></a>
<div class="memitem">
<div class="memproto">
<table class="memname"><tr>
<td class="memname">bool isGroupImmutableImpl</td>
<td>(</td>
<td class="paramtype">&nbsp;<em>self</em>, </td>
<td class="paramname"></td>
</tr><tr>
<td class="memname"></td>
<td></td>
<td class="paramtype">QByteArray&nbsp;</td>
<td class="paramname"><em>aGroup</em></td>
</tr>
<tr>
<td></td>
<td>)</td>
<td></td>
<td></td>
<td width="100%"> </td>
</tr></table>
</div>
<div class="memdoc"></div></div><a class="anchor" name="isImmutable"></a>
<div class="memitem">
<div class="memproto">
<table class="memname"><tr>
<td class="memname">bool isImmutable</td>
<td>(</td>
<td class="paramtype">&nbsp;</td>
<td class="paramname"><em>self</em>&nbsp;)</td>
<td width="100%"> </td>
</tr>
</table>
</div>
<div class="memdoc"></div></div><a class="anchor" name="locale"></a>
<div class="memitem">
<div class="memproto">
<table class="memname"><tr>
<td class="memname">QString locale</td>
<td>(</td>
<td class="paramtype">&nbsp;</td>
<td class="paramname"><em>self</em>&nbsp;)</td>
<td width="100%"> </td>
</tr>
</table>
</div>
<div class="memdoc"><p>Returns the current locale.
</p></div></div><a class="anchor" name="markAsClean"></a>
<div class="memitem">
<div class="memproto">
<table class="memname"><tr>
<td class="memname"> markAsClean</td>
<td>(</td>
<td class="paramtype">&nbsp;</td>
<td class="paramname"><em>self</em>&nbsp;)</td>
<td width="100%"> </td>
</tr>
</table>
</div>
<div class="memdoc"></div></div><a class="anchor" name="name"></a>
<div class="memitem">
<div class="memproto">
<table class="memname"><tr>
<td class="memname">QString name</td>
<td>(</td>
<td class="paramtype">&nbsp;</td>
<td class="paramname"><em>self</em>&nbsp;)</td>
<td width="100%"> </td>
</tr>
</table>
</div>
<div class="memdoc"><p>Returns the filename used to store the configuration.
</p></div></div><a class="anchor" name="readDefaults"></a>
<div class="memitem">
<div class="memproto">
<table class="memname"><tr>
<td class="memname">bool readDefaults</td>
<td>(</td>
<td class="paramtype">&nbsp;</td>
<td class="paramname"><em>self</em>&nbsp;)</td>
<td width="100%"> </td>
</tr>
</table>
</div>
<div class="memdoc"><p><dl class="return" compact><dt><b>Returns:</b></dt><dd> true if the system-wide defaults will be read instead of the
user's settings
</dd></dl>
</p></div></div><a class="anchor" name="reparseConfiguration"></a>
<div class="memitem">
<div class="memproto">
<table class="memname"><tr>
<td class="memname"> reparseConfiguration</td>
<td>(</td>
<td class="paramtype">&nbsp;</td>
<td class="paramname"><em>self</em>&nbsp;)</td>
<td width="100%"> </td>
</tr>
</table>
</div>
<div class="memdoc"><p>Updates the state of this object to match the persistent storage.
</p></div></div><a class="anchor" name="setForceGlobal"></a>
<div class="memitem">
<div class="memproto">
<table class="memname"><tr>
<td class="memname"> setForceGlobal</td>
<td>(</td>
<td class="paramtype">&nbsp;<em>self</em>, </td>
<td class="paramname"></td>
</tr><tr>
<td class="memname"></td>
<td></td>
<td class="paramtype">bool&nbsp;</td>
<td class="paramname"><em>force</em></td>
</tr>
<tr>
<td></td>
<td>)</td>
<td></td>
<td></td>
<td width="100%"> </td>
</tr></table>
</div>
<div class="memdoc"><p><dl class="deprecated" compact><dt><b>Deprecated:</b></dt><dd>
</dd></dl> </p>
<p>
Forces all following write-operations to be performed on kdeglobals,
independent of the Global flag in writeEntry().
</p>
<p>
</p><dl compact><dt><b>Parameters:</b></dt><dd>
<table border="0" cellspacing="2" cellpadding="0">
<tr><td></td><td valign="top"><em>force</em>&nbsp;</td><td> true to force writing to kdeglobals
</td></tr> </table></dl>
<p> <dl class="see" compact><dt><b>See also:</b></dt><dd> forceGlobal
</dd></dl>
</p></div></div><a class="anchor" name="setLocale"></a>
<div class="memitem">
<div class="memproto">
<table class="memname"><tr>
<td class="memname">bool setLocale</td>
<td>(</td>
<td class="paramtype">&nbsp;<em>self</em>, </td>
<td class="paramname"></td>
</tr><tr>
<td class="memname"></td>
<td></td>
<td class="paramtype">QString&nbsp;</td>
<td class="paramname"><em>aLocale</em></td>
</tr>
<tr>
<td></td>
<td>)</td>
<td></td>
<td></td>
<td width="100%"> </td>
</tr></table>
</div>
<div class="memdoc"><p>Sets the locale to <b>aLocale.</b>
</p>
<p>
The global locale is used by default.
</p>
<p>
<dl class="note" compact><dt><b>Note:</b></dt><dd> If set to the empty string, <b>no</b> locale will be matched. This effectively disables
reading translated entries.
</dd></dl> </p>
<p>
<dl class="return" compact><dt><b>Returns:</b></dt><dd> true if locale was changed, false if the call had no
effect (eg: <b>aLocale</b> was already the current locale for this
object)
</dd></dl>
</p></div></div><a class="anchor" name="setReadDefaults"></a>
<div class="memitem">
<div class="memproto">
<table class="memname"><tr>
<td class="memname"> setReadDefaults</td>
<td>(</td>
<td class="paramtype">&nbsp;<em>self</em>, </td>
<td class="paramname"></td>
</tr><tr>
<td class="memname"></td>
<td></td>
<td class="paramtype">bool&nbsp;</td>
<td class="paramname"><em>b</em></td>
</tr>
<tr>
<td></td>
<td>)</td>
<td></td>
<td></td>
<td width="100%"> </td>
</tr></table>
</div>
<div class="memdoc"><p>When set, all readEntry calls return the system-wide (default) values
instead of the user's settings.
</p>
<p>
This is off by default.
</p>
<p>
</p><dl compact><dt><b>Parameters:</b></dt><dd>
<table border="0" cellspacing="2" cellpadding="0">
<tr><td></td><td valign="top"><em>b</em>&nbsp;</td><td> whether to read the system-wide defaults instead of the
user's settings
</td></tr>
</table></dl>
<p>
</p></div></div><a class="anchor" name="sync"></a>
<div class="memitem">
<div class="memproto">
<table class="memname"><tr>
<td class="memname"> sync</td>
<td>(</td>
<td class="paramtype">&nbsp;</td>
<td class="paramname"><em>self</em>&nbsp;)</td>
<td width="100%"> </td>
</tr>
</table>
</div>
<div class="memdoc"></div></div><hr><h2>Enumeration Documentation</h2><a class="anchor" name="OpenFlag"></a>
<div class="memitem">
<div class="memproto">
<table class="memname">
<tr><td class="memname">OpenFlag</td>
</tr>
</table>
</div>
<div class="memdoc"><p>Determines how the system-wide and user's global settings will affect
the reading of the configuration.
</p>
<p>
If CascadeConfig is selected, system-wide configuration sources are used
to provide defaults for the settings accessed through this object, or
possibly to override those settings in certain cases.
</p>
<p>
IncludeGlobals does the same, but with the global settings sources.
</p>
<p>
Note that the main configuration source overrides the cascaded sources,
which override those provided to addConfigSources(), which override the
global sources. The exception is that if a key or group is marked as
being immutable, it will not be overridden.
</p>
<p>
Note that all values other than IncludeGlobals and CascadeConfig are
convenience definitions for the basic mode.
Do <b>not</b> combine them with anything.
</p><dl compact><dt><b>Enumerator: </b></dt><dd>
<table border="0" cellspacing="2" cellpadding="0"><tr><td valign="top"><em>IncludeGlobals</em>&nbsp;=&nbsp;0x01</td><td><tr><td valign="top"><em>CascadeConfig</em>&nbsp;=&nbsp;0x02</td><td><tr><td valign="top"><em>SimpleConfig</em>&nbsp;=&nbsp;0x00</td><td><tr><td valign="top"><em>NoCascade</em>&nbsp;=&nbsp;IncludeGlobals</td><td><tr><td valign="top"><em>NoGlobals</em>&nbsp;=&nbsp;CascadeConfig</td><td><tr><td valign="top"><em>FullConfig</em>&nbsp;=&nbsp;IncludeGlobals|CascadeConfig</td><td></table>
</dl>
</div></div><p>
</div>
</div>
</div>

<div id="left">

<div class="menu_box">
<div class="nav_list">
<ul>
<li><a href="../allclasses.html">Full Index</a></li>
</ul>
</div>

<a name="cp-menu" /><div class="menutitle"><div>
  <h2 id="cp-menu-project">Modules</h2>
</div></div>
<div class="nav_list">
<ul><li><a href="../akonadi/index.html">akonadi</a></li>
<li><a href="../dnssd/index.html">dnssd</a></li>
<li><a href="../kdecore/index.html">kdecore</a></li>
<li><a href="../kdeui/index.html">kdeui</a></li>
<li><a href="../khtml/index.html">khtml</a></li>
<li><a href="../kio/index.html">kio</a></li>
<li><a href="../knewstuff/index.html">knewstuff</a></li>
<li><a href="../kparts/index.html">kparts</a></li>
<li><a href="../kutils/index.html">kutils</a></li>
<li><a href="../nepomuk/index.html">nepomuk</a></li>
<li><a href="../phonon/index.html">phonon</a></li>
<li><a href="../plasma/index.html">plasma</a></li>
<li><a href="../polkitqt/index.html">polkitqt</a></li>
<li><a href="../solid/index.html">solid</a></li>
<li><a href="../soprano/index.html">soprano</a></li>
</ul></div></div>

</div>

</div>
  <div class="clearer"/>
</div>

<div id="end_body"></div>
</div>
<div id="footer"><div id="footer_text">
This documentation is maintained by <a href="&#109;&#97;&#105;&#108;&#116;&#111;&#58;simon&#64;simonzone&#46;com">Simon Edwards</a>.<br />
        KDE<sup>&#174;</sup> and <a href="../images/kde_gear_black.png">the K Desktop Environment<sup>&#174;</sup> logo</a> are registered trademarks of <a href="http://ev.kde.org/" title="Homepage of the KDE non-profit Organization">KDE e.V.</a> |
        <a href="http://www.kde.org/contact/impressum.php">Legal</a>
    </div></div>
</body>
</html>
```
